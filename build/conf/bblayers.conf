## build/conf/bblayers.conf
```bitbake
# POKY_BBLAYERS_CONF_VERSION is increased each time build/conf/bblayers.conf
# changes incompatibly
POKY_BBLAYERS_CONF_VERSION = "2"

BBPATH = "${TOPDIR}"
BBFILES ?= ""

YOCTOROOT = "${@os.path.abspath(os.path.join("${TOPDIR}", os.pardir))}"

BBLAYERS ?= " \
  ${YOCTOROOT}/layers/poky/meta \
  ${YOCTOROOT}/layers/poky/meta-poky \
  ${YOCTOROOT}/layers/meta-openembedded/meta-oe \
  ${YOCTOROOT}/layers/meta-openembedded/meta-multimedia \
  ${YOCTOROOT}/layers/meta-openembedded/meta-networking \
  ${YOCTOROOT}/layers/meta-openembedded/meta-perl \
  ${YOCTOROOT}/layers/meta-openembedded/meta-python \
  ${YOCTOROOT}/layers/meta-openembedded/meta-filesystems \
  ${YOCTOROOT}/layers/meta-virtualization \
  ${YOCTOROOT}/layers/meta-rust \
  ${YOCTOROOT}/layers/meta-arm/meta-arm \
  ${YOCTOROOT}/layers/meta-arm/meta-arm-toolchain \
  ${YOCTOROOT}/layers/meta-orangepi-r1plus-bsp \
  ${YOCTOROOT}/layers/meta-blinkos \
  "
```

## build/conf/local.conf
```bitbake
LICENSE_FLAGS_ACCEPTED = "commercial"

MACHINE ?= "orangepi-r1plus-lts"

ENABLE_UART="1"

DISTRO = "alinuxi"

SDKMACHINE = "x86_64"

RM_OLD_IMAGE = "1"

INHERIT += "rm_work"
INHERIT += "ccache"

CONF_VERSION = "1"

# Remove black border
DISABLE_OVERSCAN = "1"
```
